    LIST P=PIC16F1933
    INCLUDE "p16F1933.inc"
    __CONFIG _CONFIG1, _FCMEN_OFF & _IESO_OFF & _CLKOUTEN_OFF & _BOREN_ON & _CPD_OFF & _CP_OFF & _MCLRE_ON & _PWRTE_ON & _WDTE_OFF & _FOSC_INTOSC
    __CONFIG _CONFIG2, _LVP_ON & _BORV_LO & _STVREN_ON & _PLLEN_ON & _VCAPEN_OFF & _WRT_ALL

DISPLAY_DATA_ORIGIN EQU 0x20
DISPLAY_DATA_0 EQU 0x21
DISPLAY_DATA_1 EQU 0x22
DISPLAY_DATA_2 EQU 0x24

DISPLAY_POS EQU 0x25

INPUT_DATA EQU 0x28
INPUT_CONVERT_100 EQU 0x29
INPUT_CONVERT_10 EQU 0x2A
INPUT_CONVERT_1 EQU 0x2B

SERIAL_BUFFER0 EQU 0x30
SERIAL_BUFFER1 EQU 0x31
SERIAL_BUFFER2 EQU 0x32
SERIAL_BUFFER3 EQU 0x33

SERIAL_BUFFER_PART EQU 0x34
SERIAL_BIT_COUNT EQU 0x35
SERIAL_STATUS EQU 0x36
SERIAL_STATUS_ACTIVE EQU 0 ; ~{CS} is LOW in previous poll
SERIAL_STATUS_CLOCKED EQU 1 ; CLK is HIGH in previous poll

    ORG 0
    GOTO MAIN

    ORG 4
INTERRUPT_HANDLER
    BCF INTCON, TMR0IF
    ; turn LEDs off
    CLRF PORTC
    ; shift to next digit to turn on
    BCF STATUS, C
    RLF DISPLAY_POS, F
    BTFSC DISPLAY_POS, 3
    BSF DISPLAY_POS, 0
    BCF DISPLAY_POS, 3
    ; set the digit to turn on
    COMF DISPLAY_POS, W
    MOVWF PORTB
    XORLW 0xFF
    ; set data to display
    ADDLW DISPLAY_DATA_ORIGIN
    MOVWF FSR0L
    MOVF INDF0, W
    MOVWF PORTC

    RETFIE

FONT_TABLE
    ANDLW 0xF
    ADDWF PCL, F

    RETLW 0x3F
    RETLW 0x06
    RETLW 0x5B
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    RETLW 0x71

MAIN
    ; initialize ports
    ; PORTA[0:7] : input
    ; PORTB[0:2] : output
    ; PORTB[3:7] : input with pull-up
    ; PORTC[0:7] : output

    ; disable analog mode
    MOVLW 3
    MOVWF BSR
    CLRF ANSELA
    CLRF ANSELB
    ; set input/output
    MOVLW 1
    MOVWF BSR
    MOVLW 0xF8
    MOVWF TRISB
    CLRF TRISC
    ; enable weak pull-up, Timer0 source = FOSC/4, Timer0 Prescaler = 1:8
    MOVLW 0x42
    MOVWF OPTION_REG
    ; set system clock to 32MHz (Timer0 : about 3.9kHz)
    MOVLW 0xF0
    MOVWF OSCCON
    ; set output values
    CLRF BSR
    CLRF PORTC
    MOVLW 0x07
    MOVWF PORTB

    ; initialize program status
    CLRF FSR0H ; FSR0 : for fetching data for display (in the interrupt handler)
    CLRF FSR1H ; FSR1 : for managing data received via serial
    CLRF DISPLAY_DATA_0
    CLRF DISPLAY_DATA_1
    CLRF DISPLAY_DATA_2
    CLRF SERIAL_STATUS
    MOVLW 0x01
    MOVWF DISPLAY_POS

    ; initialize Timer0
    CLRF TMR0
    ; enable global interrupt and Timer0 interrupt
    MOVLW 0xA0
    MOVWF INTCON

MAIN_LOOP
    BTFSS PORTB, 4 ; sw2 (left)
    GOTO DIRECT_OR_SERIAL_MODE
    BTFSS PORTB, 3 ; sw1 (right)
    GOTO DECIMAL_MODE
    ; hexadecimal mode
    CLRF DISPLAY_DATA_2
    MOVF PORTA, W
    MOVWF INPUT_DATA
    CALL FONT_TABLE
    MOVWF DISPLAY_DATA_1
    SWAPF INPUT_DATA, W
    CALL FONT_TABLE
    MOVWF DISPLAY_DATA_0
    GOTO MAIN_LOOP

DECIMAL_MODE
    ; decimal mode
    MOVF PORTA, W
    MOVWF INPUT_DATA
    MOVWF INPUT_CONVERT_1
    CLRF INPUT_CONVERT_10
    CLRF INPUT_CONVERT_100

    MOVLW D'200'
    SUBWF INPUT_CONVERT_1, W
    BTFSS STATUS, C
    GOTO DECIMAL_MODE_NO_200
    MOVWF INPUT_CONVERT_1
    MOVLW D'2'
    ADDWF INPUT_CONVERT_100, F
DECIMAL_MODE_NO_200

    MOVLW D'100'
    SUBWF INPUT_CONVERT_1, W
    BTFSS STATUS, C
    GOTO DECIMAL_MODE_NO_100
    MOVWF INPUT_CONVERT_1
    INCF INPUT_CONVERT_100, F
DECIMAL_MODE_NO_100

    MOVLW D'80'
    SUBWF INPUT_CONVERT_1, W
    BTFSS STATUS, C
    GOTO DECIMAL_MODE_NO_80
    MOVWF INPUT_CONVERT_1
    MOVLW D'8'
    ADDWF INPUT_CONVERT_10, F
DECIMAL_MODE_NO_80

    MOVLW D'40'
    SUBWF INPUT_CONVERT_1, W
    BTFSS STATUS, C
    GOTO DECIMAL_MODE_NO_40
    MOVWF INPUT_CONVERT_1
    MOVLW D'4'
    ADDWF INPUT_CONVERT_10, F
DECIMAL_MODE_NO_40

    MOVLW D'20'
    SUBWF INPUT_CONVERT_1, W
    BTFSS STATUS, C
    GOTO DECIMAL_MODE_NO_20
    MOVWF INPUT_CONVERT_1
    MOVLW D'2'
    ADDWF INPUT_CONVERT_10, F
DECIMAL_MODE_NO_20

    MOVLW D'10'
    SUBWF INPUT_CONVERT_1, W
    BTFSS STATUS, C
    GOTO DECIMAL_MODE_NO_10
    MOVWF INPUT_CONVERT_1
    INCF INPUT_CONVERT_10, F
DECIMAL_MODE_NO_10

    MOVF INPUT_CONVERT_100, W
    CALL FONT_TABLE
    MOVWF DISPLAY_DATA_0
    MOVF INPUT_CONVERT_10, W
    CALL FONT_TABLE
    MOVWF DISPLAY_DATA_1
    MOVF INPUT_CONVERT_1, W
    CALL FONT_TABLE
    MOVWF DISPLAY_DATA_2
    GOTO MAIN_LOOP

DIRECT_OR_SERIAL_MODE
    BTFSS PORTB, 3 ; sw1 (right)
    GOTO SERIAL_MODE
    ; direct mode
    MOVF PORTA, W
    MOVWF DISPLAY_DATA_0
    CLRF DISPLAY_DATA_1
    CLRF DISPLAY_DATA_2
    GOTO MAIN_LOOP

SERIAL_MODE
    MOVF PORTA, W
    MOVWF INPUT_DATA
    BTFSC INPUT_DATA, 0
    GOTO SERIAL_CS_INACTIVE
    ; ~{CS} is active (LOW)
    BTFSC SERIAL_STATUS, SERIAL_STATUS_ACTIVE
    GOTO SERIAL_CS_ACTIVE_INITIALIZE_DONE
    ; ~{CS} is previously inactive : do initialization
    CLRF SERIAL_BUFFER0
    CLRF SERIAL_BUFFER1
    CLRF SERIAL_BUFFER2
    MOVLW D'8'
    MOVWF SERIAL_BIT_COUNT
    BSF SERIAL_STATUS, SERIAL_STATUS_ACTIVE
    BCF SERIAL_STATUS, SERIAL_STATUS_CLOCKED
    BTFSC INPUT_DATA, 3
    BSF SERIAL_STATUS, SERIAL_STATUS_CLOCKED
    MOVLW SERIAL_BUFFER0
    MOVWF FSR1L
SERIAL_CS_ACTIVE_INITIALIZE_DONE
    BTFSS INPUT_DATA, 3
    GOTO SERIAL_CLOCK_LOW
    ; clock is HIGH
    BTFSC SERIAL_STATUS, SERIAL_STATUS_CLOCKED
    GOTO MAIN_LOOP
    ; rising edge (previous clock is LOW)
    BSF SERIAL_STATUS, SERIAL_STATUS_CLOCKED
    ; update data
    BCF STATUS, C
    BTFSC INPUT_DATA, 1
    BSF STATUS, C
    RLF SERIAL_BUFFER_PART, F
    ; update data count
    DECFSZ SERIAL_BIT_COUNT, F
    GOTO MAIN_LOOP
    ; done receiving a byte
    MOVLW D'8'
    MOVWF SERIAL_BIT_COUNT
    MOVF FSR1L, W
    XORLW SERIAL_BUFFER3
    BTFSC STATUS, Z
    GOTO MAIN_LOOP ; buffer is full, ignore the new byte
    ; save the byte
    MOVF SERIAL_BUFFER_PART, W
    MOVWF INDF1
    INCF FSR1L, F
    GOTO MAIN_LOOP

SERIAL_CLOCK_LOW
    BCF SERIAL_STATUS, SERIAL_STATUS_CLOCKED
    GOTO MAIN_LOOP

SERIAL_CS_INACTIVE
    ; ~{CS} is inactive (HIGH)
    BTFSS SERIAL_STATUS, SERIAL_STATUS_ACTIVE
    GOTO MAIN_LOOP
    ; ~{CS} is previously active
    BCF SERIAL_STATUS, SERIAL_STATUS_ACTIVE
    ; update display
    MOVF SERIAL_BUFFER0, W
    MOVWF DISPLAY_DATA_0
    MOVF SERIAL_BUFFER1, W
    MOVWF DISPLAY_DATA_1
    MOVF SERIAL_BUFFER2, W
    MOVWF DISPLAY_DATA_2
    GOTO MAIN_LOOP

    END
